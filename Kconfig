## Kconfig
```kconfig
# Copyright (c) 2020 The ZMK Contributors
# SPDX-License-Identifier: MIT

config ZMK_USER_CONFIG
    bool
    default y

rsource "boards/$(ARCH)/*/Kconfig.defconfig"
```

## boards/arm/my60ble/Kconfig.board
```kconfig
# Copyright (c) 2020 The ZMK Contributors
# SPDX-License-Identifier: MIT

config BOARD_MY60BLE
    bool "My 60% BLE Keyboard"
    depends on SOC_NRF52840_QIAA
```

## config/arm/my60ble/Kconfig.defconfig
```kconfig
# Copyright (c) 2020 The ZMK Contributors
# SPDX-License-Identifier: MIT

if BOARD_MY60BLE

config BOARD
    default "my60ble"

config ZMK_KEYBOARD_NAME
    default "My 60% BLE"

if USB_DEVICE_STACK

config USB_NRFX
    default y

endif # USB_DEVICE_STACK

config BT_CTLR
    default BT

config ZMK_BLE
    default y

config ZMK_USB
    default y

config ZMK_BATTERY_REPORT_INTERVAL
    default 60

endif # BOARD_MY60BLE
```

## zmk-config-fixed/boards/arm/my60ble/Kconfig.defconfig
```kconfig
if BOARD_MY60BLE
config BOARD
    default "my60ble"
config ZMK_KEYBOARD_NAME
    default "My 60% BLE"
if USB_DEVICE_STACK
config USB_NRFX
    default y
endif
config BT_CTLR
    default BT
config ZMK_BLE
    default y
config ZMK_USB
    default y
endif
```
